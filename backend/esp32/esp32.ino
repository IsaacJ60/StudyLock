#include <WiFi.h>
#include <HTTPClient.h>
#include <ArduinoJson.h>

// wifi credentials
const char* ssid = "Victor's iPhone";
const char* password = "WinHacks2025ESP32";

// api keys
const char* openai_api_key = "your_OPENAI_API_KEY";

// replace with actual gpio pins
const int micPin = 34; 
const int speakerPin = 25;

String recordedText = ""; // text recorded by skainet
String generatedText = ""; // text generated by openai
String prePrompt = "You are a friend to the user.
 You are contained inside a shark-cat plushie, however you do not mention this to the user at all. 
 You help the user with their focus, to remind them sometimes on their work, and to be a general friend. 
 The following message after this will be the user's message. Reply using the info I gave you. USER PROMPT: "; // pre-prompt to guide the ai

void setup() {
  Serial.begin(115200);
  WiFi.begin(ssid, password);

  while (WiFi.status() != WL_CONNECTED) {
    delay(1000);
    Serial.println("Connecting to WiFi...");
  }

  Serial.println("Connected to WiFi");

  // initialize skainet and audio setup here
}

void loop() {
  // user audio using skainet here
  recordedText = getSpeechToText();

  // send text to openai for ai response
  if (!recordedText.isEmpty()) {
    generatedText = getOpenAIResponse(recordedText);
    Serial.println("Generated Text: " + generatedText);

    // convert ai response to audio
    if (!generatedText.isEmpty()) {
      playTextToSpeech(generatedText);
    }
  }

  delay(10000); // wait 10s before repeating
}

// placeholder for skainet voice recog (figure out tmrw)
String getSpeechToText() {
  // temporary placeholder text xdxd
  return "Hello, how can I help you?";
}

// function to get response from openai
String getOpenAIResponse(String prompt) {
  HTTPClient http;
  String response = "";

  if (WiFi.status() == WL_CONNECTED) {
    http.begin("https://api.openai.com/v1/engines/davinci-codex/completions");
    http.addHeader("Content-Type", "application/json");
    http.addHeader("Authorization", "Bearer " + String(openai_api_key));

    // combine preprompt with user input
    String fullPrompt = prePrompt + prompt;

    String payload = 
      "{\"prompt\": \"" + fullPrompt + "\", "
      "\"max_tokens\": 50}";

    int httpResponseCode = http.POST(payload);

    if (httpResponseCode > 0) {
      response = http.getString();
      Serial.println(response);

      // parse json response
      DynamicJsonDocument doc(1024);
      deserializeJson(doc, response);
      String generatedText = doc["choices"][0]["text"];
      return generatedText;

    } else {
      Serial.print("Error on sending POST: ");
      Serial.println(httpResponseCode);
    }

    http.end();
  }
  return response;
}

// text to speech function
void playTextToSpeech(String text) {
  HTTPClient http;

  if (WiFi.status() == WL_CONNECTED) {
    http.begin("https://api.openai.com/v1/audio/speech");
    http.addHeader("Content-Type", "application/json");
    http.addHeader("Authorization", "Bearer " + String(openai_api_key));

    String payload = 
      "{\"input\": {"
      "\"text\": \"" + text + "\"}, "
      "\"voice\": {\"languageCode\": \"en-US\"}, "
      "\"audioConfig\": {\"audioEncoding\": \"MP3\"}}";

    int httpResponseCode = http.POST(payload);

    if (httpResponseCode > 0) {
      String response = http.getString();
      Serial.println(response);

      // parse json response
      DynamicJsonDocument doc(2048);
      deserializeJson(doc, response);
      String audioContent = doc["audioContent"];

      // do audio shit 🔥
      playAudio(audioContent);

    } else {
      Serial.print("Error on sending POST: ");
      Serial.println(httpResponseCode);
    }

    http.end();
  }
}

// function to play audio (placeholder)
void playAudio(String audioContent) {
  // figure it out man
}
